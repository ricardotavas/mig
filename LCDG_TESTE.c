/*----------------------------------------------------------------------------
 *      Biblioteca:	LPC176x_LCD.lib
 *      Proposito:	Biblioteca com funções para LCD
 *----------------------------------------------------------------------------
 *      Arquivo:    LCDG_128x64.c
 *      Proposito: 	Funções para LCD gráfico de 128x64 dots
 *----------------------------------------------------------------------------
 *      Versão: 	1.00 	Prog: Ricardo T.   Data: 25/04/2013
 * 		Descrição:  Versão inicial
 *----------------------------------------------------------------------------
 *      Este código pertence a Wyma Tecnologia e Sistemas LTDA.
 *---------------------------------------------------------------------------*/

#include	<stdio.h>
#include 	"LCD_BASE.h"

/*----------------------------------------------------------------------------
 *      Tabela de caracteres
 *---------------------------------------------------------------------------*/

static const unsigned char TabelaASC [224][6]={
0x00,0x00,0x00,0x00,0x00, 0x00,	//  	- 32
0x00,0x00,0x4F,0x00,0x00, 0x00,	// !	- 33
0x00,0x07,0x00,0x07,0x00, 0x00,	// "	- 34
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0x00,0x00,0x00,0x00,0x00, 0x00,	//  	- 255
};						  

/*----------------------------------------------------------------------------
 *      Local variables
 *---------------------------------------------------------------------------*/
unsigned char posicao_line;

/*----------------------------------------------------------------------------
 *      Local functions
 *---------------------------------------------------------------------------*/
void lcdgraf_init (void);
void lcdgraf_Write_Command (unsigned char chip, unsigned char commandByte);
void lcdgraf_Write_Data (unsigned char chip, unsigned char dataByte);
void lcdgraf_gotoxy (unsigned char x, unsigned char y);
void lcdgraf_putc (char databyte, unsigned char reverse);
void lcdgraf_puts (char *buf, unsigned char reverse);
void lcdgraf_showpicture (IMGSCR *buf, unsigned char iniPag);
void lcdgraf_clear (void);
void lcdgraf_putcconst (const char databyte, unsigned char reverse);
void lcdgraf_putsconst (const char *buf, unsigned char reverse);
void lcdgraf_fillname (char *buf, unsigned char reverse);
void lcdgraf_power (unsigned char status);
void lcdgraf_backlight (unsigned char status);

/*-------------------------------------------------------------------------------------------
 * Função: 		lcdgraf_init
 * Descrição: 	Inicializa através de comandos o LCD Gráfico
 * Parâmetros: 	Nenhum
 * Retorno: 	Nenhum
 -------------------------------------------------------------------------------------------*/
void lcdgraf_init (void) 
{
	init_lcd_io ();				
						 
	lcdgraf_backlight (0);

	SPI_Write (0);							// Send data through SPI to shift register 595.

	RESET_IO (0);
	RESET_IO (1);

	lcdgraf_Write_Command (CHIP1, 0x40);	// Set the Y address in the Y address counter
	lcdgraf_Write_Command (CHIP2, 0x40);
   	
	lcdgraf_Write_Command (CHIP1, 0xB8);	// Set the X addres at the X address register
	lcdgraf_Write_Command (CHIP2, 0xB8);
	
   	lcdgraf_Write_Command (CHIP1, 0xC0);	// Indicates the display data RAM displayed at the top of the Screen
	lcdgraf_Write_Command (CHIP2, 0xC0);

	lcdgraf_power (1);						// Liga display LCD

	lcdgraf_clear ();						// Limpa o LCD
}

/*-------------------------------------------------------------------------------------------
 * Função: 		lcdgraf_Write_Command
 * Descrição: 	Envia byte de comando para o LCD
 * Parâmetros: 	chip - Seleciona 1 dos 2 chips do LCD gráfico
 *				commandByte - Comando a ser enviado para o LCD
 * Retorno: 	Nenhum
 -------------------------------------------------------------------------------------------*/
void lcdgraf_Write_Command (unsigned char chip, unsigned char commandByte) 
{
   	RS_IO(0);								// Set pin RS to Low - Write Command 
	if (chip==CHIP1)
		CS_IO (1);							// Set pin CS - Chip Select	1 ou 2
	else 
		CS_IO (0);
	RW_IO(0);								// Set pin RW to Low - Enabled for Write 

	SPI_Write (commandByte);				// Envia comando por SPI para o shift register 595.

   	EN_IO (1);								// Habilita LCD 
   	EN_IO (0);								// Desabilita LCD 
}

/*-------------------------------------------------------------------------------------------
 * Função: 		lcdgraf_Write_Data
 * Descrição: 	Envia byte de dado para o LCD
 * Parâmetros: 	chip - Seleciona 1 dos 2 chips do LCD gráfico
 *				dataByte - Dado a ser enviado para o LCD
 * Retorno: 	Nenhum
 -------------------------------------------------------------------------------------------*/
void lcdgraf_Write_Data (unsigned char chip, unsigned char dataByte) 
{
   	RS_IO(1);								// Set pin RS to High - Write Data
	if (chip==CHIP1)
		CS_IO (1);							// Set pin CS - Chip Select	1 ou 2
	else 
		CS_IO (0);
	RW_IO(0);								// Set pin RW to Low - Enabled for Write 
	
	SPI_Write (dataByte);					// Envia dado por SPI para o shift register 595.

   	EN_IO (1);								// Habilita LCD 
   	EN_IO (0);								// Desabilita LCD 
}

/*-------------------------------------------------------------------------------------------
 * Função: 		lcdgraf_gotoxy
 * Descrição: 	Posiciona o dot a ser modificado do LCD 
 * Parâmetros: 	x - Posição no eixo X
 *				y - Posição no eixo Y
 * Retorno: 	Nenhum
 -------------------------------------------------------------------------------------------*/
void lcdgraf_gotoxy (unsigned char x, unsigned char y)
{
	posicao_line = (x-1)*6;

	// Posição inicial é no CHIP1:
	if (posicao_line<64)
	{
		// Posiciona X e Y do primeiro chip
		lcdgraf_Write_Command(CHIP1, (posicao_line) | 0x40);
		lcdgraf_Write_Command(CHIP1, (y-1) | 0xB8);
		// Posiciona X=0 e Y do segundo chip
		lcdgraf_Write_Command(CHIP2, 0 | 0x40);
		lcdgraf_Write_Command(CHIP2, (y-1) | 0xB8);
	}
	// Posição inicial é no CHIP2:
	else if (posicao_line<128)
	{
		// Posiciona X e Y do segundo chip
		lcdgraf_Write_Command(CHIP2, (posicao_line) | 0x40);
		lcdgraf_Write_Command(CHIP2, (y-1) | 0xB8);
	}
}

/*-------------------------------------------------------------------------------------------
 * Função: 		LCD_putc
 * Descrição: 	Mostra um caractere no LCD na corrente posição do cursor
 * Parâmetros: 	databyte - Byte do caractere
 *				reverse - Opção para inverter cor dos pontos
 * Retorno: 	Nenhum
 -------------------------------------------------------------------------------------------*/
void lcdgraf_putc (char databyte, unsigned char reverse)
{
	unsigned char cont=0;																			 
	
	for(cont=0 ; cont<6 ; cont++,posicao_line++)
	{
		if (posicao_line<64)
		{
			if (reverse)
				lcdgraf_Write_Data(CHIP1,TabelaASC[databyte-32][cont]^0xFF);
			else
				lcdgraf_Write_Data(CHIP1,TabelaASC[databyte-32][cont]);
		}
		else if (posicao_line<128)
		{
			if (reverse)
				lcdgraf_Write_Data(CHIP2,TabelaASC[databyte-32][cont]^0xFF);
			else
				lcdgraf_Write_Data(CHIP2,TabelaASC[databyte-32][cont]);
		}
	}
}

/*-------------------------------------------------------------------------------------------
 * Função: 		lcdgraf_putcconst
 * Descrição: 	Mostra um caractere a partir de constante no LCD na corrente posição do cursor
 * Parâmetros: 	databyte - Byte do caractere
 *				reverse - Opção para inverter cor dos pontos
 * Retorno: 	Nenhum
 -------------------------------------------------------------------------------------------*/
void lcdgraf_putcconst (const char databyte, unsigned char reverse)
{
	unsigned char cont=0;																			 
	for(cont=0 ; cont<6 ; cont++,posicao_line++)
	{
		if (posicao_line<64)
		{
			if (reverse)
				lcdgraf_Write_Data(CHIP1,TabelaASC[databyte-32][cont]^0xFF);
			else
				lcdgraf_Write_Data(CHIP1,TabelaASC[databyte-32][cont]);
		}
		else if (posicao_line<128)
		{
			if (reverse)
				lcdgraf_Write_Data(CHIP2,TabelaASC[databyte-32][cont]^0xFF);
			else
				lcdgraf_Write_Data(CHIP2,TabelaASC[databyte-32][cont]);
		}
	}
}

/*-------------------------------------------------------------------------------------------
 * Função: 		lcdgraf_puts
 * Descrição: 	Mostra um conj de caracteres no LCD na corrente posição do cursor
 * Parâmetros: 	buf - Ponteiro para a área de RAM com os dados
 *				reverse - Opção para inverter cor dos pontos
 * Retorno: 	Nenhum
 -------------------------------------------------------------------------------------------*/
void lcdgraf_puts (char *buf, unsigned char reverse) 
{
   	while (*buf) 
	{
		if (reverse)
      		lcdgraf_putc (*buf++,1);
		else
			lcdgraf_putc (*buf++,0);
   	}
}

/*-------------------------------------------------------------------------------------------
 * Função: 		lcdgraf_putsconst
 * Descrição: 	Mostra um conj de caracteres no LCD na corrente posição do cursor
 * Parâmetros: 	buf - Ponteiro para a área de RAM CONST com os dados
 *				reverse - Opção para inverter cor dos pontos
 * Retorno: 	Nenhum
 -------------------------------------------------------------------------------------------*/
void lcdgraf_putsconst (const char *buf, unsigned char reverse) 
{
   	while (*buf) 
	{
		if (reverse)
			lcdgraf_putcconst (*buf++,1);
		else
      		lcdgraf_putcconst (*buf++,0);
   	}
}

/*-------------------------------------------------------------------------------------------
 * Função: 		lcdgraf_fillname
 * Descrição: 	
 * Parâmetros: 	buf - Ponteiro para a área de RAM com os dados
 *				reverse - Opção para inverter cor dos pontos
 * Retorno: 	Nenhum
 -------------------------------------------------------------------------------------------*/
void lcdgraf_fillname (char *buf, unsigned char reverse)
{
	unsigned char cont=0;

   	while (*buf) 
	{
      	if (reverse)
			lcdgraf_putc (*buf++,1);
		else
			lcdgraf_putc (*buf++,0);
		cont++;
   	}
	while (cont<17)
	{
		if (reverse)
			lcdgraf_putc (' ',1);
		else
			lcdgraf_putc (' ',0);
		cont++;
	}

}

/*-------------------------------------------------------------------------------------------
 * Função: 		lcdgraf_CompileBitmap
 * Descrição: 	Lê arquivo bitmap e formata os dados para mostrar no LCD Gráfico
 * Parâmetros: 	*filebmp - Ponteiro para o arquivo bitmap
 *				*buf - Ponteiro para estrutura com o buffer de destino dos dados
 * Retorno: 	(0) Não foi possível Compilar (1) Compilação OK
 -------------------------------------------------------------------------------------------*/
char lcdgraf_CompileBitmap(FILE *filebmp, IMGSCR *buf)	
{    
	unsigned char file[LEN_BMP_SCR];
	unsigned short lenFile=0;
	int byteFile=0;
	unsigned short offSet;
	unsigned short bitsPixel; 
	unsigned short widthBytes;
	
	unsigned short cntHeight=0;
	unsigned short cntWidth=0;
	unsigned char posBitSrc=0;
	unsigned char byte=0;
	unsigned short cntBitWidth=0;
	unsigned short cntByteDest=0;
    unsigned char posBitDest=0;

	while ((byteFile=fgetc (filebmp)) != EOF)
	{
		file[lenFile++] = (unsigned char) byteFile;
		if (lenFile==LEN_BMP_SCR)  				// Tamanho do arquivo não pode ser maior que o buffer 
			return 0;							// do compilador
	}

    if (file[0]=='B' && file[1]=='M')			// Verifica a assinatura de arquivo bitmap
	{
		offSet = (unsigned short)((file[13]<<24) | (file[12]<<16) | (file[11]<<8) | file[10]);
		buf->width = (unsigned short)((file[21]<<24) | (file[20]<<16) | (file[19]<<8) | file[18]);
		buf->height = (unsigned short)((file[25]<<24) | (file[24]<<16) | (file[23]<<8) | file[22]);
		bitsPixel = (file[29]<<8) | file[28];
	}
	else
		return 0;

	if ((buf->width!=0) && (buf->height!=0) && (buf->width<=128) && (buf->height<=64))	
	{
		if (bitsPixel==1)
		{
			widthBytes = (buf->width +7) / 8;
			while ((widthBytes%4)!=0) widthBytes++;


			for (cntHeight=0 ; cntHeight<buf->height ; cntHeight++)
			{
				for (cntWidth=0 ; cntWidth<widthBytes ; cntWidth++)
				{
				   	for (posBitSrc=128, posBitDest=7 ; posBitSrc!=0 ; posBitSrc/=2 , posBitDest--)
					{
						byte = file [offSet+((cntHeight*widthBytes)+cntWidth)] & posBitSrc;
						if (byte!=0) byte=1;
					
						if (file[BEGIN_COLOR_TABLE + (byte * 4) + 1]>0x80)
							buf->bitmap[cntByteDest] |= (1<<posBitDest);
						else
							buf->bitmap[cntByteDest] &= ~(0<<posBitDest);
					}
					cntByteDest++;
					cntBitWidth++;
					if (cntBitWidth==buf->width)
					{
						cntBitWidth=0;
						while (cntWidth != widthBytes) cntWidth++;
						break;
					}
				}
			}
			if (cntHeight==buf->height)
				return 1;
		}
	}

	return 0;
}   

/*-------------------------------------------------------------------------------------------
 * Função: 		lcdgraf_show

 * Descrição: 	Mostra no LCD a imagem armazenada no buffer
 * Parâmetros: 	iniPag - Pagina inicial do LCD para mostrar o grafico
 * Retorno: 	Nenhum
 -------------------------------------------------------------------------------------------*/
void lcdgraf_showpicture (IMGSCR *buf, unsigned char iniPag)
{
	unsigned char x,y,z,page,ALTERADO,col,bitcol;
	unsigned char *pont;
	
	pont=buf->bitmap;

	page=iniPag;
	col=0;
	ALTERADO=0;
	for(x=0;x<8;x++)
	{
		for (z=128;z!=0;z=z/2)
		{
			page=0;
			bitcol=128;
			for (y=0;y<(64-(iniPag*8));y++)
			{	
				if (pont[y*x] & z)
				//if (picture[y][x] & z)
					ALTERADO |= bitcol;
				bitcol/=2;
				if ((y+1)%8==0)
				{
					lcdgraf_Write_Command(CHIP1,page8-page);
					lcdgraf_Write_Command (CHIP1, 0x40+col);
					lcdgraf_Write_Data(CHIP1,ALTERADO);
					ALTERADO=0;
					page++;
					bitcol=128;
				}
			}
			col++;
		}
	}
	page=iniPag;
	col=0;
	ALTERADO=0;
	for(x=8;x<16;x++)
	{
		for (z=128;z!=0;z=z/2)
		{
			page=0;
			bitcol=128;
			for (y=0;y<(64-(iniPag*8));y++)
			{	
				if (pont[y*x] & z)
				//if (picture[y][x] & z)
					ALTERADO |= bitcol;
				bitcol/=2;
				if ((y+1)%8==0)
				{
					lcdgraf_Write_Command(CHIP2,page8-page);
					lcdgraf_Write_Command (CHIP2, 0x40+col);
					lcdgraf_Write_Data(CHIP2,ALTERADO);
					ALTERADO=0;
					page++;
					bitcol=128;
				}
			}
			col++;
		}
	}
}

/*-------------------------------------------------------------------------------------------
 * Função: 		lcdgraf_clear
 * Descrição: 	Limpa a tela do LCD.
 * Parâmetros: 	nenhum
 * Retorno: 	Nenhum
 -------------------------------------------------------------------------------------------*/

void lcdgraf_clear (void)
{
	unsigned char x,y;

	lcdgraf_Write_Command(CHIP1,page1);	
	for(y=0;y<8;y++)
	{
		lcdgraf_Write_Command(CHIP1,page1+y);	
		for(x=0;x<64;x++)
		{
			lcdgraf_Write_Data(CHIP1,0x00);
		}
	}

	lcdgraf_Write_Command(CHIP2,page1);
	for(y=0;y<8;y++)
	{
		lcdgraf_Write_Command(CHIP2,page1+y);
		for(x=0;x<64;x++)
		{
			lcdgraf_Write_Data(CHIP2,0x00);
		}
	}
}

/*-------------------------------------------------------------------------------------------
 * Função: 		lcdgraf_power
 * Descrição: 	Liga/Desliga o LCD
 * Parâmetros: 	status - (0) Desliga (1) Liga
 * Retorno: 	Nenhum
 -------------------------------------------------------------------------------------------*/

void lcdgraf_power (unsigned char status)
{
	if (status)
	{
		lcdgraf_Write_Command(CHIP1,0x3F);
		lcdgraf_Write_Command(CHIP2,0x3F);
	}
	else
	{
		lcdgraf_Write_Command(CHIP1,0x3E);
		lcdgraf_Write_Command(CHIP2,0x3E);
	}
}

/*-------------------------------------------------------------------------------------------
 * Função: 		lcdgraf_backlight
 * Descrição: 	Muda o estado do LCD 
 * Parâmetros: 	status - (0)desliga backlight, (1) liga backlight
 * Retorno: 	Nenhum
 -------------------------------------------------------------------------------------------*/

void lcdgraf_backlight (unsigned char status) 
{
   	if (status)
   		BKL_IO (0);
	else
   		BKL_IO (1);
}

/*----------------------------------------------------------------------------
 * end of file
 *---------------------------------------------------------------------------*/
